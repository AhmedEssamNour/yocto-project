## build/conf/bblayers.conf
```bitbake
# This template file was created by taking the oe-core/meta/conf/bblayers.conf
# file and removing the BBLAYERS section at the end.

# LAYER_CONF_VERSION is increased each time build/conf/bblayers.conf
# changes incompatibly
LCONF_VERSION = "7"

BBPATH = "${TOPDIR}"
BBFILES ?= ""

# Layers configured by oe-core-setup script
BBLAYERS += " \
	/home/aessam/repos/yocto-project/sources/meta-tisdk/meta-ti-foundational \
	/home/aessam/repos/yocto-project/sources/meta-tisdk/meta-ti-ml \
	/home/aessam/repos/yocto-project/sources/meta-arago/meta-arago-distro \
	/home/aessam/repos/yocto-project/sources/meta-arago/meta-arago-extras \
	/home/aessam/repos/yocto-project/sources/meta-arago/meta-arago-test \
	/home/aessam/repos/yocto-project/sources/meta-qt6 \
	/home/aessam/repos/yocto-project/sources/meta-virtualization \
	/home/aessam/repos/yocto-project/sources/meta-openembedded/meta-networking \
	/home/aessam/repos/yocto-project/sources/meta-openembedded/meta-python \
	/home/aessam/repos/yocto-project/sources/meta-openembedded/meta-oe \
	/home/aessam/repos/yocto-project/sources/meta-openembedded/meta-gnome \
	/home/aessam/repos/yocto-project/sources/meta-openembedded/meta-filesystems \
	/home/aessam/repos/yocto-project/sources/meta-openembedded/meta-multimedia \
	/home/aessam/repos/yocto-project/sources/meta-ti/meta-ti-extras \
	/home/aessam/repos/yocto-project/sources/meta-ti/meta-beagle \
	/home/aessam/repos/yocto-project/sources/meta-ti/meta-ti-bsp \
	/home/aessam/repos/yocto-project/sources/meta-arm/meta-arm \
	/home/aessam/repos/yocto-project/sources/meta-arm/meta-arm-toolchain \
	/home/aessam/repos/yocto-project/sources/oe-core/meta \
"
```
